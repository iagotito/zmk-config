## config/boards/shields/klotz/Kconfig.shield
```kconfig
config SHIELD_KLOTZ_LEFT
    def_bool y
    depends on SHIELD_KLOTZ

config SHIELD_KLOTZ_RIGHT
    def_bool y
    depends on SHIELD_KLOTZ

config SHIELD_KLOTZ
    bool "Klotz keyboard"
```
